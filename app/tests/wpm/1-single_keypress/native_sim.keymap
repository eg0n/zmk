#include "../behavior_keymap.dtsi"

&kscan {
    events = <
        ZMK_MOCK_PRESS(0,0,10)
        ZMK_MOCK_RELEASE(0,0,10)
        /* 12 wpm over the first second, falling as time passes, then 0 once the key leaves the
           5 second window, after which the updates stop */
        ZMK_MOCK_PRESS(0,0,6000)
    >;
};