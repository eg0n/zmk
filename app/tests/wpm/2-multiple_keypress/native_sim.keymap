#include "../behavior_keymap.dtsi"

&kscan {
    events = <
        ZMK_MOCK_PRESS(0,0,10)
        ZMK_MOCK_RELEASE(0,0,10)
        // 12wpm - 1 key press in the first second, recalculated every 250ms
        ZMK_MOCK_PRESS(0,0,1000)
        ZMK_MOCK_RELEASE(0,0,10)
        // 19wpm - 2 key presses in 1.25 seconds, falling to 8wpm - 2 key presses in 3 seconds
        ZMK_MOCK_PRESS(0,0,2000)
    >;
};